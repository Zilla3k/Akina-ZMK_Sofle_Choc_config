## config/west.yml
```yaml
manifest:
  remotes:
    - name: zmkfirmware
      url-base: https://github.com/zmkfirmware
    - name: victorlucachi
      url-base: https://github.com/victorlucachi

  projects:
    - name: zmk
      remote: zmkfirmware
      revision: v0.2
      import: app/west.yml
    - name: charybdis-zmk-module
      remote: victorlucachi
      revision: main

  self:
    path: config
```
